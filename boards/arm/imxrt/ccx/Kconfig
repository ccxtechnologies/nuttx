## boards/arm/imxrt/ccx/Kconfig
```kconfig
#
# For a description of the syntax of this configuration file,
# see the file kconfig-language.txt in the NuttX tools repository.
#

if ARCH_BOARD_CCX && BOOT_RUNFROMFLASH

config CCX_QSPI_FLASH
	bool "SIP QSPI Flash"
	default y

endif
```
